## meta-textbook-application-external/conf/layer.conf
```bitbake
# We have a conf and classes directory, add to BBPATH
BBPATH .= ":${LAYERDIR}"

# We have recipes-* directories, add to BBFILES
BBFILES += "${LAYERDIR}/recipes-*/*/*.bb \
            ${LAYERDIR}/recipes-*/*/*.bbappend"

BBFILE_COLLECTIONS += "meta-textbook-application-external"
BBFILE_PATTERN_meta-textbook-application-external = "^${LAYERDIR}/"
BBFILE_PRIORITY_meta-textbook-application-external = "6"

LAYERDEPENDS_meta-textbook-application-external = "core"
LAYERSERIES_COMPAT_meta-textbook-application-external = "scarthgap"
```

## meta-textbook-application/conf/layer.conf
```bitbake
# We have a conf and classes directory, add to BBPATH
BBPATH .= ":${LAYERDIR}"

# We have recipes-* directories, add to BBFILES
BBFILES += "${LAYERDIR}/recipes-*/*/*.bb \
            ${LAYERDIR}/recipes-*/*/*.bbappend \
            ${LAYERDIR}/appends/*/*.bbappend \
            "

BBFILE_COLLECTIONS += "meta-textbook-application"
BBFILE_PATTERN_meta-textbook-application = "^${LAYERDIR}/"
BBFILE_PRIORITY_meta-textbook-application = "6"

LAYERDEPENDS_meta-textbook-application = "core"
LAYERSERIES_COMPAT_meta-textbook-application = "scarthgap"
```

## meta-textbook-core-bsp-external/conf/layer.conf
```bitbake
# We have a conf and classes directory, add to BBPATH
BBPATH .= ":${LAYERDIR}"

# We have recipes-* directories, add to BBFILES
BBFILES += "${LAYERDIR}/recipes-*/*/*.bb \
            ${LAYERDIR}/recipes-*/*/*.bbappend"

BBFILE_COLLECTIONS += "meta-textbook-core-bsp-external"
BBFILE_PATTERN_meta-textbook-core-bsp-external = "^${LAYERDIR}/"
BBFILE_PRIORITY_meta-textbook-core-bsp-external = "6"

LAYERDEPENDS_meta-textbook-core-bsp-external = "core"
LAYERSERIES_COMPAT_meta-textbook-core-bsp-external = "scarthgap"
```

## meta-textbook-core-bsp/conf/layer.conf
```bitbake
# We have a conf and classes directory, add to BBPATH
BBPATH .= ":${LAYERDIR}"

# We have recipes-* directories, add to BBFILES
BBFILES += "${LAYERDIR}/recipes-*/*/*.bb \
            ${LAYERDIR}/recipes-*/*/*.bbappend"

BBFILE_COLLECTIONS += "meta-textbook-core-bsp"
BBFILE_PATTERN_meta-textbook-core-bsp = "^${LAYERDIR}/"
BBFILE_PRIORITY_meta-textbook-core-bsp = "6"

LAYERDEPENDS_meta-textbook-core-bsp = "core"
LAYERSERIES_COMPAT_meta-textbook-core-bsp = "scarthgap"
```

## meta-textbook-core-bsp/conf/machine/textbook.conf
```bitbake
# ORIGIN: poky/meta/conf/machine/qemuarm64.conf
# @TYPE: Machine
# @NAME: QEMU ARMv8 machine
# @DESCRIPTION: Machine configuration for running an ARMv8 system on QEMU

# Include tuning settings for ARMv8-A architecture (Cortex-A57)
require conf/machine/include/arm/armv8a/tune-cortexa57.inc

# Include common QEMU machine configuration
require conf/machine/include/textbook-qemu.inc

# ---------------------------------------------------------------------------
# Kernel image configuration
# ---------------------------------------------------------------------------
# KERNEL_IMAGETYPE:
#   - Specifies the output format of the built kernel image.
#   - For ARM64, "Image" is the standard uncompressed kernel image.
KERNEL_IMAGETYPE = "Image"

# ---------------------------------------------------------------------------
# U-Boot configuration
# ---------------------------------------------------------------------------
# UBOOT_MACHINE:
#   - Defines which U-Boot defconfig should be used during the build.
#   - qemu_arm64_defconfig is tailored for QEMU ARM64 environments.
UBOOT_MACHINE ?= "qemu_arm64_defconfig"

# ---------------------------------------------------------------------------
# Serial console configuration
# ---------------------------------------------------------------------------
# SERIAL_CONSOLES:
#   - Defines serial ports and baud rates for the QEMU environment.
#   - "ttyAMA0" is the ARM PL011 UART.
#   - "hvc0" is the QEMU hypervisor console.
SERIAL_CONSOLES ?= "115200;ttyAMA0 115200;hvc0"

# MACHINEOVERRIDES:
#   - Extends Yocto's override mechanism.
#   - Adding ":textbook" allows applying additional textbook-specific settings.
MACHINEOVERRIDES =. ":textbook"

# ---------------------------------------------------------------------------
# Kernel build settings
# ---------------------------------------------------------------------------

# KBUILD_DEFCONFIG:
#   - The default defconfig used when building the kernel.
#   - Refers to arch/arm64/configs/defconfig in the kernel source tree.
KBUILD_DEFCONFIG = "defconfig"

# Kernel version and custom extension
# LINUX_VERSION:
#   - Specifies the kernel version to use.
# LINUX_VERSION_EXTENSION:
#   - Appends a custom suffix to the kernel version (useful for custom builds).
LINUX_VERSION ?= "6.6"
LINUX_VERSION_EXTENSION ?= "-textbook"

# Select the default provider for virtual/kernel.
# This machine uses the linux-textbook recipe as its kernel.
PREFERRED_PROVIDER_virtual/kernel = "linux-textbook"
```

## meta-textbook-core/conf/distro/textbook-core-distro.conf
```bitbake
# Basic distro identity and metadata.
DISTRO ?= "textbook-core-distro"
DISTRO_NAME ?= "Textbook Core Distro (Textbook Core Distro)"
DISTRO_VERSION ?= "1.0.0"
DISTRO_CODENAME ?= "scarthgap"

# SDK metadata used for naming and packaging the generated SDK.
SDK_VENDOR ?= "-textbooksdk"
SDK_VERSION ?= "${@d.getVar('DISTRO_VERSION').replace('snapshot-${METADATA_REVISION}', 'snapshot')}"
SDK_VERSION[vardepvalue] = "${SDK_VERSION}"

# Maintainer information for documentation and metadata.
MAINTAINER ?= "dylan.hong <dylanhong920509@gmail.com>"

# Vendor suffix appended to target triplets and package naming.
TARGET_VENDOR ?= "-textbook"

# Local configuration versioning (rarely used, but kept for compatibility).
LOCALCONF_VERSION ?= "2"

# Default settings intended to be overridden by core-based distros.
# These define baseline features and package dependencies for the distro.
CORE_DEFAULT_DISTRO_FEATURES = "multiarch"
CORE_DEFAULT_EXTRA_RDEPENDS = "packagegroup-textbook-core"
CORE_DEFAULT_EXTRA_RRECOMMENDS = "kernel-module-af-packet"

# Combine default distro features with core-specific defaults.
DISTRO_FEATURES ?= "${DISTRO_FEATURES_DEFAULT} ${CORE_DEFAULT_DISTRO_FEATURES}"

# Select preferred kernel versions (regular and real-time variants).
PREFERRED_VERSION_linux-yocto ?= "6.6%"
PREFERRED_VERSION_linux-yocto-rt ?= "6.6%"

# SDK naming and installation path configuration.
# These values determine how the SDK is packaged and where it is installed.
SDK_NAME = "${DISTRO}-${TCLIBC}-${SDKMACHINE}-${IMAGE_BASENAME}-${TUNE_PKGARCH}-${MACHINE}"
SDKPATHINSTALL = "/opt/${DISTRO}/${SDK_VERSION}"

# Add core-level runtime dependencies and recommendations to the distro.
DISTRO_EXTRA_RDEPENDS += "${CORE_DEFAULT_EXTRA_RDEPENDS}"
DISTRO_EXTRA_RRECOMMENDS += "${CORE_DEFAULT_EXTRA_RRECOMMENDS}"

# Placeholder for additional C library configuration (currently unused).
TCLIBCAPPEND = ""

# Select the package format used by the distro (RPM by default).
PACKAGE_CLASSES ?= "package_rpm"

# List of host distributions that have been tested and validated for sanity checks.
# This helps detect unsupported or unstable build environments.
SANITY_TESTED_DISTROS ?= " \
            poky-4.3 \n \
            poky-5.0 \n \
            ubuntu-20.04 \n \
            ubuntu-22.04 \n \
            ubuntu-23.04 \n \
            ubuntu-24.04 \n \
            fedora-38 \n \
            fedora-39 \n \
            fedora-40 \n \
            fedora-41 \n \
            centos-8 \n \
            centos-9 \n \
            debian-11 \n \
            debian-12 \n \
            opensuseleap-15.4 \n \
            almalinux-8.8 \n \
            almalinux-8.9 \n \
            almalinux-8.10 \n \
            almalinux-9.2 \n \
            almalinux-9.4 \n \
            rocky-8 \n \
            rocky-9 \n \
            "

# Enable Poky’s extended sanity checks to validate the build environment.
INHERIT += "poky-sanity"

# Optional QA settings (currently aligned with OE-Core defaults).
#WARN_TO_ERROR_QA = "X"
#WARN_QA_remove = "${WARN_TO_ERROR_QA}"
#ERROR_QA_append = " ${WARN_TO_ERROR_QA}"

# Include common distro-level configuration fragments.
# - no-static-libs: removes static libraries to reduce image size.
# - yocto-uninative: ensures host-OS-independent native toolchain.
# - security_flags: enables hardened compiler/linker flags.
require conf/distro/include/no-static-libs.inc
require conf/distro/include/yocto-uninative.inc
require conf/distro/include/security_flags.inc

# Enable uninative support (host glibc independence).
INHERIT += "uninative"

# Configure signature and hash equivalence handling for reproducible builds.
BB_SIGNATURE_HANDLER ?= "OEEquivHash"
BB_HASHSERVE ??= "auto"

# Default init system for this distro (can be overridden by derived distros).
CORE_INIT_MANAGER = "sysvinit"
INIT_MANAGER ?= "${CORE_INIT_MANAGER}"

# Include kernel debug symbols to support SPDX license manifest generation.
KERNEL_EXTRA_FEATURES:append = " features/debug/debug-kernel.scc"

# Enable automatic generation of SPDX license manifests.
INHERIT += "create-spdx"
```

## meta-textbook-core/conf/distro/textbook-systemd-distro.conf
```bitbake
# Load the base distro configuration. This file provides the common
# settings shared across all core-based distros. The current file
# overrides and extends those settings to create a systemd-enabled distro.
require conf/distro/textbook-core-distro.conf

# Basic distro identity and metadata.
DISTRO ?= "textbook-systemd-distro"
DISTRO_NAME ?= "Textbook Systemd Distro (Textbook Systemd Distro)"
DISTRO_VERSION ?= "1.0.0"
DISTRO_CODENAME = "scarthgap"

# SDK metadata used for naming and packaging the generated SDK.
SDK_VENDOR = "-systemdsdk"
SDK_VERSION = "${@d.getVar('DISTRO_VERSION').replace('snapshot-${METADATA_REVISION}', 'snapshot')}"

# ---------------------------------------------------------------------
# Systemd configuration overrides
# ---------------------------------------------------------------------
# Enable systemd and usrmerge support. The usrmerge feature is required
# by systemd in modern Yocto releases, as systemd expects a unified
# /usr filesystem layout.
DISTRO_FEATURES:append = " systemd usrmerge"

# Remove sysvinit support to avoid conflicts with systemd.
DISTRO_FEATURES:remove = " sysvinit"

# Select systemd as the init manager and disable sysvinit scripts.
VIRTUAL-RUNTIME_init_manager = "systemd"
VIRTUAL-RUNTIME_initscripts = "systemd-compat-units"

# Prevent Yocto from automatically reintroducing sysvinit through
# backfill mechanisms.
DISTRO_FEATURES_BACKFILL_CONSIDERED = "sysvinit"

# Provide compatibility units for legacy init scripts when needed.
VIRTUAL-RUNTIME_initscript = "systemd-compat-units"
```

## meta-textbook-core/conf/layer.conf
```bitbake
# We have a conf and classes directory, add to BBPATH
BBPATH .= ":${LAYERDIR}"

# We have recipes-* directories, add to BBFILES
BBFILES += "${LAYERDIR}/recipes-*/*/*.bb \
            ${LAYERDIR}/recipes-*/*/*.bbappend"

BBFILE_COLLECTIONS += "meta-textbook-core"
BBFILE_PATTERN_meta-textbook-core = "^${LAYERDIR}/"
BBFILE_PRIORITY_meta-textbook-core = "6"

LAYERDEPENDS_meta-textbook-core = "core"
LAYERSERIES_COMPAT_meta-textbook-core = "scarthgap"
```

## meta-textbook-external/conf/layer.conf
```bitbake
# We have a conf and classes directory, add to BBPATH
BBPATH .= ":${LAYERDIR}"

# We have recipes-* directories, add to BBFILES
BBFILES += "${LAYERDIR}/recipes-*/*/*.bb \
            ${LAYERDIR}/recipes-*/*/*.bbappend"

BBFILE_COLLECTIONS += "meta-textbook-external"
BBFILE_PATTERN_meta-textbook-external = "^${LAYERDIR}/"
BBFILE_PRIORITY_meta-textbook-external = "6"

LAYERDEPENDS_meta-textbook-external = "core"
LAYERSERIES_COMPAT_meta-textbook-external = "scarthgap"
```

## meta-textbook-rootfs/conf/layer.conf
```bitbake
# We have a conf and classes directory, add to BBPATH
BBPATH .= ":${LAYERDIR}"

# We have recipes-* directories, add to BBFILES
BBFILES += "${LAYERDIR}/recipes-*/*/*.bb \
            ${LAYERDIR}/recipes-*/*/*.bbappend \
            ${LAYERDIR}/appends/*/*.bbappend"

BBFILE_COLLECTIONS += "meta-textbook-rootfs"
BBFILE_PATTERN_meta-textbook-rootfs = "^${LAYERDIR}/"
BBFILE_PRIORITY_meta-textbook-rootfs = "6"

LAYERDEPENDS_meta-textbook-rootfs = "core meta-textbook-core"
LAYERSERIES_COMPAT_meta-textbook-rootfs = "scarthgap"
```

## meta-textbook-sdk/conf/layer.conf
```bitbake
# We have a conf and classes directory, add to BBPATH
BBPATH .= ":${LAYERDIR}"

# We have recipes-* directories, add to BBFILES
BBFILES += "${LAYERDIR}/recipes-*/*/*.bb \
            ${LAYERDIR}/recipes-*/*/*.bbappend \
            ${LAYERDIR}/appends/*/*.bbappend"

BBFILE_COLLECTIONS += "meta-textbook-sdk"
BBFILE_PATTERN_meta-textbook-sdk = "^${LAYERDIR}/"
BBFILE_PRIORITY_meta-textbook-sdk = "6"

LAYERDEPENDS_meta-textbook-sdk = "core"
LAYERSERIES_COMPAT_meta-textbook-sdk = "scarthgap"
```

## meta-textbook-selinux/conf/layer.conf
```bitbake
# We have a conf and classes directory, add to BBPATH
BBPATH .= ":${LAYERDIR}"

# We have recipes-* directories, add to BBFILES
BBFILES += "${LAYERDIR}/recipes-*/*/*.bb \
            ${LAYERDIR}/recipes-*/*/*.bbappend"

BBFILE_COLLECTIONS += "meta-textbook-selinux"
BBFILE_PATTERN_meta-textbook-selinux = "^${LAYERDIR}/"
BBFILE_PRIORITY_meta-textbook-selinux = "6"

LAYERDEPENDS_meta-textbook-selinux = "core"
LAYERSERIES_COMPAT_meta-textbook-selinux = "scarthgap"

# Include the SELinux feature configuration
# to apply the necessary settings
# for enabling SELinux support in the build.
require conf/feature/textbook-selinux-feature.conf
```

## meta-thirdparty/conf/layer.conf
```bitbake
# We have a conf and classes directory, add to BBPATH
BBPATH .= ":${LAYERDIR}"

# We have recipes-* directories, add to BBFILES
BBFILES += "${LAYERDIR}/recipes-*/*/*.bb \
            ${LAYERDIR}/recipes-*/*/*.bbappend \
            ${LAYERDIR}/appends/*/*.bbappend \
            "

BBFILE_COLLECTIONS += "meta-thirdparty"
BBFILE_PATTERN_meta-thirdparty = "^${LAYERDIR}/"
BBFILE_PRIORITY_meta-thirdparty = "6"

LAYERDEPENDS_meta-thirdparty = "core"
LAYERSERIES_COMPAT_meta-thirdparty = "scarthgap"
```
